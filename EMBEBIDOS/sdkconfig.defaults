## EMBEBIDOS/sdkconfig.defaults
```kconfig
CONFIG_FREERTOS_HZ=1000

CONFIG_FREERTOS_USE_TRACE_FACILITY=y
CONFIG_FREERTOS_GENERATE_RUN_TIME_STATS=y

CONFIG_FREERTOS_CHECK_STACKOVERFLOW_CANARY=y

CONFIG_ESP_TASK_WDT=y
CONFIG_ESP_TASK_WDT_TIMEOUT_S=5

CONFIG_LOG_DEFAULT_LEVEL_INFO=y

CONFIG_COMPILER_CXX_EXCEPTIONS=y
CONFIG_COMPILER_CXX_RTTI=y

CONFIG_ESP_INT_WDT=y
CONFIG_ESP_SYSTEM_PANIC_PRINT_REBOOT=y

CONFIG_FREERTOS_SUPPORT_STATIC_ALLOCATION=y

CONFIG_HEAP_POISONING_LIGHT=y

CONFIG_ESPTOOLPY_FLASHSIZE_2MB=y
```
